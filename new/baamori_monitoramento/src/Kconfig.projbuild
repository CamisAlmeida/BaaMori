## new/baamori_monitoramento/src/Kconfig.projbuild
```kconfig
menu "Application Configuration"

config TB_TOKEN
    string "ThingsBoard Token"

config WEB_HOST
    string "Web Server Host"

config WEB_PORT
    int "Web Server Port"
    default 8000

endmenu
```
